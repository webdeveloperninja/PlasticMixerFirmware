# file: Extrusion.ioc
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FREERTOS.Tasks01=defaultTask,0,128,StartDefaultTask,Default,NULL,Dynamic,NULL,NULL
Mcu.Family=STM32F4
Mcu.Name=STM32F446R(C-E)Tx
Mcu.Package=LQFP64
NVIC.EXTI15_10_IRQn=true\:5\:0\:false\:false\:true\:true\:true\:true\:true
NVIC.PriorityGroup=NVIC_PRIORITYGROUP_4
PC13.GPIO_ModeDefaultEXTI=GPIO_MODE_IT_RISING_FALLING
PC13.GPIO_PuPd=GPIO_NOPULL
PC13.Signal=GPXTI13
ProjectManager.HeapSize=0x200
ProjectManager.StackSize=0x400
ProjectManager.TargetToolchain=STM32CubeIDE
RCC.CortexFreq_Value=16000000
RCC.USBFreq_Value=96000000
RCC.VCOOutputFreq_Value=192000000
VP_FREERTOS_VS_CMSIS_V1.Mode=CMSIS_V1
board=custom

// file: Core/Src/main.c
/* USER CODE BEGIN Header */
/**
  ******************************************************************************
  * @file           : main.c
  * @brief          : Main program body
  ******************************************************************************
  * @attention
  *
  * Copyright (c) 2024 STMicroelectronics.
  * All rights reserved.
  *
  * This software is licensed under terms that can be found in the LICENSE file
  * in the root directory of this software component.
  * If no LICENSE file comes with this software, it is provided AS-IS.
  *
  ******************************************************************************
  */
/* USER CODE END Header */
#include "main.h"
#include "cmsis_os.h"

/* USER CODE BEGIN Includes */
#include <stdio.h>
#include "FreeRTOS.h"
#include "task.h"

/* USER CODE END Includes */

/* USER CODE BEGIN PD */

#define TRUE 1
#define FALSE 0

/* USER CODE END PD */

osThreadId defaultTaskHandle;

void SystemClock_Config(void);
static void MX_GPIO_Init(void);
void StartDefaultTask(void const * argument);

/* USER CODE BEGIN PFP */

void StartAdditiveMaterialMotorClockwise();
void StopAdditiveMaterialMotor();
void CalibrateVirginMaterialFlow();
void SetCalibrationValveOpen();
void SetCalibrationValveClosed();
void StartFeed();
void StopFeed();
void StartAdditiveMotorTask(void *argument);
void CalibrateAdditiveMaterialFlow();
int GetHopperMassGrams();

/* USER CODE END PFP */

/* USER CODE BEGIN 0 */

// SET FROM CALIBRATION PROCESS
int VirginMaterialGramsPerSecond = 0;

// USER INPUT FROM HMI
int VirginMaterialGramsPerCup = 30;

// USER INPUT FROM HMI
int AdditivePercentRate = 2;

// SET FROM CALIBRATION
int AdditiveMaterialMotorStepsPerSecond = 100;

int GramsPerAdditiveMotorStep = 0;

int CalculateAdditiveMaterialMotorSpeedIntervalSeconds = 30;

// This will be the digital out for a relay to power 24 V pump
int CalibrationValveOpen = FALSE;

// This will be a limit switch state.
int CalibrationTubeFull = FALSE;

TaskHandle_t xStartAdditiveMotorTaskHandle = NULL;

void StartFeed()
{
    if (xStartAdditiveMotorTaskHandle == NULL)
    {
        xTaskCreate(
        	StartAdditiveMotorTask,
			"StartAdditiveMotorTask",
			configMINIMAL_STACK_SIZE,
			NULL,
			2,
			&xStartAdditiveMotorTaskHandle
		);
    }
}

void StopFeed()
{
	StopAdditiveMaterialMotor();

	if (xStartAdditiveMotorTaskHandle != NULL)
	{
		vTaskDelete(xStartAdditiveMotorTaskHandle);
		xStartAdditiveMotorTaskHandle = NULL;
	}
}

void StartAdditiveMotorTask(void *argument)
{
    const TickType_t calculateAdditiveMaterialMotorSpeedInterval = CalculateAdditiveMaterialMotorSpeedIntervalSeconds * 1000 / portTICK_PERIOD_MS;

    while (1)
    {
        CalibrateVirginMaterialFlow();
        CalibrateAdditiveMaterialFlow();

        float AdditiveMaterialGramsPerCup = (VirginMaterialGramsPerCup * AdditivePercentRate) / 100.0f;
        float AdditiveMaterialGramsPerSecond = AdditiveMaterialGramsPerCup * VirginMaterialGramsPerSecond / VirginMaterialGramsPerCup;

        AdditiveMaterialMotorStepsPerSecond = (int)(AdditiveMaterialGramsPerSecond / GramsPerAdditiveMotorStep);

        StartAdditiveMaterialMotorClockwise(AdditiveMaterialMotorStepsPerSecond);

        printf("Virgin Material Flow Calibration Task\n");
        vTaskDelay(calculateAdditiveMaterialMotorSpeedInterval);
    }
}

void CalibrateVirginMaterialFlow() {
    TickType_t xStartTime, xEndTime;
    int timeToFillMilliseconds;

    SetCalibrationValveOpen();

    xStartTime = xTaskGetTickCount();

    int pollCalibrationTubeStatusDelayMS = 10;
    while (CalibrationTubeFull == FALSE) {
        vTaskDelay(pollCalibrationTubeStatusDelayMS / portTICK_PERIOD_MS);
    }

    xEndTime = xTaskGetTickCount();

    SetCalibrationValveClosed();

    timeToFillMilliseconds = (xEndTime - xStartTime) * portTICK_PERIOD_MS;
    VirginMaterialGramsPerSecond = (float) VirginMaterialGramsPerCup / (timeToFillMilliseconds / 1000.0f);

    printf("Virgin Material Flow Rate: %d grams/second\n", VirginMaterialGramsPerSecond);
}

void CalibrateAdditiveMaterialFlow()
{
	int startingHopperWeight = GetHopperMassGrams();

	StartAdditiveMaterialMotorClockwise(AdditiveMaterialMotorStepsPerSecond);

	int calibrationMaterialTimeSeconds = 5;
    vTaskDelay((calibrationMaterialTimeSeconds * 1000) / portTICK_PERIOD_MS);

    StopAdditiveMaterialMotor();

	int endingHopperWeight = GetHopperMassGrams();

	int weightDifference = endingHopperWeight - startingHopperWeight;
	float gramsPerSecond = weightDifference / (float)calibrationMaterialTimeSeconds;

    int totalSteps = AdditiveMaterialMotorStepsPerSecond * calibrationMaterialTimeSeconds;

    GramsPerAdditiveMotorStep = weightDifference / (float)totalSteps;
}

void StartAdditiveMaterialMotorClockwise(int stepsPerSeconds)
{
	// Assume Calibrated Here
	// Calculate Speed And Set Motor Clockwise
	// TODO: Implement
}

void StopAdditiveMaterialMotor()
{
	// TODO: Implement
}

void SetCalibrationValveOpen()
{
	// TODO: Implement
	CalibrationValveOpen = TRUE;
}

void SetCalibrationValveClosed()
{
	// TODO: Implement
	CalibrationValveOpen = FALSE;
}

int GetHopperMassGrams()
{
	// TODO: poll 4 load cells and calculate grams

	return 44;
}

void HAL_GPIO_EXTI_Callback(uint16_t GPIO_Pin)
{
    if (GPIO_Pin == GPIO_PIN_13)
    {
        if (HAL_GPIO_ReadPin(GPIOC, GPIO_PIN_13) == GPIO_PIN_RESET)
        {
            CalibrationTubeFull = TRUE;
            printf("Button Pressed - CalibrationTubeFull set to TRUE\n");
        }
        else // Pin is low (button released)
        {
            CalibrationTubeFull = FALSE;
            printf("Button Released - CalibrationTubeFull set to FALSE\n");
        }
    }
}

/* USER CODE END 0 */

int main(void)
{

  /* MCU Configuration--------------------------------------------------------*/

  /* Reset of all peripherals, Initializes the Flash interface and the Systick. */
  HAL_Init();

  /* Configure the system clock */
  SystemClock_Config();

  /* Initialize all configured peripherals */
  MX_GPIO_Init();

  /* Create the thread(s) */
  /* definition and creation of defaultTask */
  osThreadDef(defaultTask, StartDefaultTask, osPriorityNormal, 0, 128);
  defaultTaskHandle = osThreadCreate(osThread(defaultTask), NULL);

  /* USER CODE BEGIN RTOS_THREADS */

  // TODO: This will move to an interrupt triggering on HMI Feed button
  StartFeed();

  /* add threads, ... */
  /* USER CODE END RTOS_THREADS */

  /* Start scheduler */
  osKernelStart();

  /* We should never get here as control is now taken by the scheduler */

  /* Infinite loop */
  while (1)
  {

  }
}

void SystemClock_Config(void)
{
  RCC_OscInitTypeDef RCC_OscInitStruct = {0};
  RCC_ClkInitTypeDef RCC_ClkInitStruct = {0};

  /** Configure the main internal regulator output voltage
  */
  __HAL_RCC_PWR_CLK_ENABLE();
  __HAL_PWR_VOLTAGESCALING_CONFIG(PWR_REGULATOR_VOLTAGE_SCALE3);

  /** Initializes the RCC Oscillators according to the specified parameters
  * in the RCC_OscInitTypeDef structure.
  */
  RCC_OscInitStruct.OscillatorType = RCC_OSCILLATORTYPE_HSI;
  RCC_OscInitStruct.HSIState = RCC_HSI_ON;
  RCC_OscInitStruct.HSICalibrationValue = RCC_HSICALIBRATION_DEFAULT;
  RCC_OscInitStruct.PLL.PLLState = RCC_PLL_NONE;
  if (HAL_RCC_OscConfig(&RCC_OscInitStruct) != HAL_OK)
  {
    Error_Handler();
  }

  /** Initializes the CPU, AHB and APB buses clocks
  */
  RCC_ClkInitStruct.ClockType = RCC_CLOCKTYPE_HCLK|RCC_CLOCKTYPE_SYSCLK
                              |RCC_CLOCKTYPE_PCLK1|RCC_CLOCKTYPE_PCLK2;
  RCC_ClkInitStruct.SYSCLKSource = RCC_SYSCLKSOURCE_HSI;
  RCC_ClkInitStruct.AHBCLKDivider = RCC_SYSCLK_DIV1;
  RCC_ClkInitStruct.APB1CLKDivider = RCC_HCLK_DIV1;
  RCC_ClkInitStruct.APB2CLKDivider = RCC_HCLK_DIV1;

  if (HAL_RCC_ClockConfig(&RCC_ClkInitStruct, FLASH_LATENCY_0) != HAL_OK)
  {
    Error_Handler();
  }
}

static void MX_GPIO_Init(void)
{
  GPIO_InitTypeDef GPIO_InitStruct = {0};

  /* GPIO Ports Clock Enable */
  __HAL_RCC_GPIOC_CLK_ENABLE();

  /*Configure GPIO pin : PC13 */
  GPIO_InitStruct.Pin = GPIO_PIN_13;
  GPIO_InitStruct.Mode = GPIO_MODE_IT_RISING_FALLING;
  GPIO_InitStruct.Pull = GPIO_NOPULL;
  HAL_GPIO_Init(GPIOC, &GPIO_InitStruct);

  /* EXTI interrupt init*/
  HAL_NVIC_SetPriority(EXTI15_10_IRQn, 5, 0);
  HAL_NVIC_EnableIRQ(EXTI15_10_IRQn);

}

void StartDefaultTask(void const * argument)
{
  for(;;)
  {
    osDelay(1);
  }
}

void Error_Handler(void)
{
  __disable_irq();
  while (1)
  {
  }
}
